## components/dfplayer/Kconfig
```kconfig
menu "DFPlayer configuration"

config DFPLAYER_ENABLE
    bool "Enable DFPlayer support"
    default y if CONFIG_BOARD_TYPE_BREAD_COMPACT_ESP32

config DFPLAYER_UART_NUM
    int "UART port number for DFPlayer (1 or 2)"
    default 2 if CONFIG_BOARD_TYPE_BREAD_COMPACT_ESP32
    default 1

config DFPLAYER_TX_PIN
    int "ESP TX -> DFPlayer RX pin"
    # Defaults for ESP32 DevKit V1: use GPIO17 for TX
    default 17 if CONFIG_BOARD_TYPE_BREAD_COMPACT_ESP32
    default 17

config DFPLAYER_RX_PIN
    int "ESP RX <- DFPlayer TX pin"
    # Defaults for ESP32 DevKit V1: use GPIO16 for RX
    default 16 if CONFIG_BOARD_TYPE_BREAD_COMPACT_ESP32
    default 16

config DFPLAYER_BAUD
    int "DFPlayer UART baud rate"
    default 9600

config DFPLAYER_AUTO_START
    bool "Start DFPlayer task on boot"
    default y

config DFPLAYER_VOLUME
    int "Default DFPlayer volume (0-30)"
    default 20

endmenu
```
